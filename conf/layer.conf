## conf/layer.conf
```bitbake
# We have a conf and classes directory, add to BBPATH
BBPATH .= ":${LAYERDIR}"

# We have recipes-* directories, add to BBFILES
BBFILES += "${LAYERDIR}/recipes-*/*/*.bb \
            ${LAYERDIR}/recipes-*/*/*.bbappend"

BBFILE_COLLECTIONS += "mender-standalone-daemon"
BBFILE_PATTERN_mender-standalone-daemon = "^${LAYERDIR}/"

INHERIT += "mender-standalone-daemon-vars"

LAYERDEPENDS_mender-standalone-daemon = "                               \
                                          core                          \
                                          mender                        \
                                          bitbake-variable-substitution \
                                        "

LAYERSERIES_COMPAT_mender-standalone-daemon = "kirkstone mickledore nanbield"
```
